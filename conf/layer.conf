## conf/layer.conf
```bitbake
# We have a conf and classes directory, add to BBPATH
BBPATH .= ":${LAYERDIR}"

# We have recipes-* directories, add to BBFILES
BBFILES += "${LAYERDIR}/recipes-*/*/*.bb \
            ${LAYERDIR}/recipes-*/*/*.bbappend"

BBFILE_COLLECTIONS += "nanowires"
BBFILE_PATTERN_nanowires = "^${LAYERDIR}/"
BBFILE_PRIORITY_nanowires = "10"

LAYERSERIES_COMPAT_nanowires = "nanbield"
```
